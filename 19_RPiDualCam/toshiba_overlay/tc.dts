/dts-v1/;

/ {
	compatible = "brcm,bcm2835";

	fragment@0 {
		target = < 0xffffffff >;

		__overlay__ {
			#address-cells = < 0x01 >;
			#size-cells = < 0x00 >;
			status = "okay";

			tc358743@0f {
				compatible = "toshiba,tc358743";
				reg = < 0x0f >;
				status = "okay";
				clocks = < 0x01 >;
				clock-names = "refclk";

				bridge-clk {
					compatible = "fixed-clock";
					#clock-cells = < 0x00 >;
					clock-frequency = < 0x19bfcc0 >;
					phandle = < 0x01 >;
				};

				port {

					endpoint {
						remote-endpoint = < 0x02 >;
						clock-lanes = < 0x00 >;
						clock-noncontinuous;
						link-frequencies = < 0x00 0x1cf7c580 >;
						phandle = < 0x03 >;
					};
				};
			};
		};
	};

	fragment@1 {
		target = < 0xffffffff >;

		__overlay__ {
			status = "okay";

			port {

				endpoint {
					remote-endpoint = < 0x03 >;
					phandle = < 0x02 >;
				};
			};
		};
	};

	fragment@2 {
		target = < 0xffffffff >;

		__overlay__ {

			tc358743@0f {

				port {

					endpoint {
						data-lanes = < 0x01 0x02 >;
					};
				};
			};
		};
	};

	fragment@3 {
		target = < 0xffffffff >;

		__dormant__ {

			tc358743@0f {

				port {

					endpoint {
						data-lanes = < 0x01 0x02 0x03 0x04 >;
					};
				};
			};
		};
	};

	fragment@4 {
		target = < 0xffffffff >;

		__dormant__ {
			brcm,pins = < 0x1c 0x1d >;
			brcm,function = < 0x04 >;
		};
	};

	fragment@5 {
		target = < 0xffffffff >;

		__overlay__ {
			brcm,pins = < 0x2c 0x2d >;
			brcm,function = < 0x05 >;
		};
	};

	fragment@6 {
		target = < 0xffffffff >;

		__dormant__ {
			brcm,pins = < 0x00 0x01 >;
			brcm,function = < 0x04 >;
		};
	};

	fragment@7 {
		target = < 0xffffffff >;

		__overlay__ {
			status = "okay";
		};
	};

	__overrides__ {
		i2c_pins_0_1 = "\0\0\0\0-4-5+6";
		i2c_pins_28_29 = "\0\0\0\0+4-5-6";
		4lane = [ 00 00 00 00 2d 32 2b 33 00 ];
		link-frequency = [ 00 00 00 03 6c 69 6e 6b 2d 66 72 65 71 75 65 6e 63 69 65 73 23 30 00 ];
	};

	__symbols__ {
		tc358743_clk = "/fragment@0/__overlay__/tc358743@0f/bridge-clk";
		tc358743 = "/fragment@0/__overlay__/tc358743@0f/port/endpoint";
		csi1_ep = "/fragment@1/__overlay__/port/endpoint";
	};

	__fixups__ {
		i2c_vc = "/fragment@0:target:0\0/fragment@2:target:0\0/fragment@3:target:0\0/fragment@7:target:0";
		csi1 = "/fragment@1:target:0";
		i2c0_pins = "/fragment@4:target:0\0/fragment@5:target:0\0/fragment@6:target:0";
	};

	__local_fixups__ {

		fragment@0 {

			__overlay__ {

				tc358743@0f {
					clocks = < 0x00 >;

					port {

						endpoint {
							remote-endpoint = < 0x00 >;
						};
					};
				};
			};
		};

		fragment@1 {

			__overlay__ {

				port {

					endpoint {
						remote-endpoint = < 0x00 >;
					};
				};
			};
		};

		__overrides__ {
			link-frequency = < 0x00 >;
		};
	};
};
